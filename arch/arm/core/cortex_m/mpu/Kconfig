## arch/arm/core/cortex_m/mpu/Kconfig
```kconfig
# Kconfig - Memory Protection Unit (MPU) configuration options

#
# Copyright (c) 2017 Linaro Limited
#
# SPDX-License-Identifier: Apache-2.0
#

config ARM_MPU
	bool "ARM MPU Support"
	depends on CPU_HAS_MPU
	depends on SOC_FAMILY_ARM || SOC_FAMILY_STM32
	default n
	help
	  MCU has ARM MPU

config ARM_MPU_ALLOW_FLASH_WRITE
	bool "Add ARM MPU access to write to flash"
	depends on ARM_MPU
	default n
	help
	  Enable this to allow MPU RW access to flash memory
```

## arch/arm/soc/nordic_nrf5/nrf51/Kconfig.defconfig.nrf51822
```kconfig
# Kconfig.defconfig.nrf51822 - Nordic Semiconductor nRF51822 MCU
#
# Copyright (c) 2016 Linaro Limited
#
# Licensed under the Apache License, Version 2.0 (the "License");
# you may not use this file except in compliance with the License.
# You may obtain a copy of the License at
#
#     http://www.apache.org/licenses/LICENSE-2.0
#
# Unless required by applicable law or agreed to in writing, software
# distributed under the License is distributed on an "AS IS" BASIS,
# WITHOUT WARRANTIES OR CONDITIONS OF ANY KIND, either express or implied.
# See the License for the specific language governing permissions and
# limitations under the License.
#

if SOC_NRF51822

config SOC
	string
	default nRF51822

config SYS_CLOCK_HW_CYCLES_PER_SEC
	int
	default 16000000

config SRAM_SIZE
	default 16

config FLASH_SIZE
	default 128

config NUM_IRQS
	int
	default 25

endif # SOC_NRF51822
```

## arch/arm/soc/st_stm32/stm32f4/Kconfig.defconfig.series
```kconfig
# Kconfig.defconfig.series - ST Microelectronics STM32F4 MCU line
#
# Copyright (c) 2016 Linaro Limited
#
# Licensed under the Apache License, Version 2.0 (the "License");
# you may not use this file except in compliance with the License.
# You may obtain a copy of the License at
#
#     http://www.apache.org/licenses/LICENSE-2.0
#
# Unless required by applicable law or agreed to in writing, software
# distributed under the License is distributed on an "AS IS" BASIS,
# WITHOUT WARRANTIES OR CONDITIONS OF ANY KIND, either express or implied.
# See the License for the specific language governing permissions and
# limitations under the License.
#

if SOC_SERIES_STM32F4X

source "arch/arm/soc/st_stm32/stm32f4/Kconfig.defconfig.stm32f4*"

config SOC_SERIES
	default stm32f4

config NUM_IRQ_PRIO_BITS
        int
        default 4

config KERNEL_INIT_PRIORITY_DEFAULT
	default 40

config KERNEL_INIT_PRIORITY_DEVICE
	default 50

config SRAM_BASE_ADDRESS
        default 0x20000000

config FLASH_BASE_ADDRESS
        default 0x08000000

config PERIPHERAL_BASE_ADDRESS
    hex
    default 0x40000000
    help
    The memory address for the Peripheral register location.

config VECTOR_TABLE_IN_SRAM
    bool
    default false
    help
    If you need to relocate the vector table to internal SRAM, set this
    value to true.

choice
	prompt "Select the clock source for the PLL"
	default SOC_STM32_CLOCK_HSI
	depends on SOC_SERIES_STM32F4X

config SOC_STM32_CLOCK_HSE
	bool
	prompt "High speed external clock"
	help
	Use the High Speed External clock signal (HSE)

config SOC_STM32_CLOCK_HSI
	bool
	prompt "High speed internal clock"
	help
	Use the High Speed Internal clock signal (HSI)

endchoice

config SYS_CLOCK_HW_CYCLES_PER_SEC
	int
	default 168000000


endif #SOC_SERIES_STM32F4X
```

## arch/arm/soc/st_stm32/stm32f4/Kconfig.defconfig.stm32f401re
```kconfig
# Kconfig - ST STM32F401RE MCU configuration options
#
# Copyright (c) 2016 Linaro Limited.
#
# Licensed under the Apache License, Version 2.0 (the "License");
# you may not use this file except in compliance with the License.
# You may obtain a copy of the License at
#
#     http://www.apache.org/licenses/LICENSE-2.0
#
# Unless required by applicable law or agreed to in writing, software
# distributed under the License is distributed on an "AS IS" BASIS,
# WITHOUT WARRANTIES OR CONDITIONS OF ANY KIND, either express or implied.
# See the License for the specific language governing permissions and
# limitations under the License.
#

if SOC_STM32F401RE

config SOC
	string
	default stm32f401re

config NUM_IRQS
	int
	# must be >= the highest interrupt number used
	# - include the UART interrupts
	default 78

config SRAM_SIZE
	default 128

config FLASH_SIZE
	default 96

endif #SOC_STM32F401RE
```

## arch/arm/soc/st_stm32/stm32f4/Kconfig.soc
```kconfig
# Kconfig.soc - ST Microelectronics STM32F4 MCU line
#
# Copyright (c) 2016 Pawel Wodnicki 32bitmicro.com
#               2016 Linaro Limited.
#
# Licensed under the Apache License, Version 2.0 (the "License");
# you may not use this file except in compliance with the License.
# You may obtain a copy of the License at
#
#     http://www.apache.org/licenses/LICENSE-2.0
#
# Unless required by applicable law or agreed to in writing, software
# distributed under the License is distributed on an "AS IS" BASIS,
# WITHOUT WARRANTIES OR CONDITIONS OF ANY KIND, either express or implied.
# See the License for the specific language governing permissions and
# limitations under the License.
#

config SOC_STM32F401RE
	bool
	default n
	help
	SoC selection is done automatically when you pick a board. It is a hidden
	option that you should not set directly.

config SOC_STM32F446RE
	bool
	default n
	help
	SoC selection is done automatically when you pick a board. It is a hidden
	option that you should not set directly.
```

## arch/arm/soc/st_stm32/stm32f4/Kconfig.soc.family
```kconfig
# Kconfig.soc.family - ST STM32F4xx family SOC configuration options
#
# Copyright (c) 2016 Pawel Wodnicki 32bitmicro.com
#
# Licensed under the Apache License, Version 2.0 (the "License");
# you may not use this file except in compliance with the License.
# You may obtain a copy of the License at
#
#     http://www.apache.org/licenses/LICENSE-2.0
#
# Unless required by applicable law or agreed to in writing, software
# distributed under the License is distributed on an "AS IS" BASIS,
# WITHOUT WARRANTIES OR CONDITIONS OF ANY KIND, either express or implied.
# See the License for the specific language governing permissions and
# limitations under the License.
#

choice
prompt "STM32F4x MCU Selection"
depends on SOC_STM32F4X

config SOC_STM32F446RE
	bool "ST STM32F466RE MCU"

endchoice

if SOC_STM32F4X

source "arch/arm/soc/st_stm32/stm32f4/Kconfig.soc.stm32f4*"

config SOC
	default st_stm32/stm32f4

config NUM_IRQ_PRIO_BITS
        int
        default 3

config KERNEL_INIT_PRIORITY_DEFAULT
	default 40

config KERNEL_INIT_PRIORITY_DEVICE
	default 50

config SRAM_BASE_ADDRESS
        default 0x20000000

config FLASH_BASE_ADDRESS
        default 0x08000000

config PERIPHERAL_BASE_ADDRESS
    hex
    default 0x40000000
    help
    The memory address for the Peripheral register location.

config FSMC_REGISTER_BASE_ADDRESS
	hex
	default 0xA0000000
	help
	This is the memory address for the Flexible Static Memory Controller
	(FSMC) registers.

config VECTOR_TABLE_IN_SRAM
    bool
    default false
    help
    If you need to relocate the vector table to internal SRAM, set this
    value to true.

choice
	prompt "Select the clock source for the PLL"
	default SOC_STM32_CLOCK_HSE
	depends on SOC_STM32F4X

config SOC_STM32_CLOCK_HSE
	bool
	help
	Use the High Speed External clock signal (HSE)

config SOC_STM32_CLOCK_HSI
	bool
	help
	Use the High Speed Internal clock signal (HSI)

endchoice

config SYS_CLOCK_HW_CYCLES_PER_SEC
	int
	default 168000000


endif #SOC_STM32F4X
```

## arch/arm/soc/st_stm32/stm32f4/Kconfig.soc.stm32f446re
```kconfig
# Kconfig - ST STM32F446RE MCU configuration options

#
# Copyright (c) 2016 Pawel Wodnicki.
#
# Licensed under the Apache License, Version 2.0 (the "License");
# you may not use this file except in compliance with the License.
# You may obtain a copy of the License at
#
#     http://www.apache.org/licenses/LICENSE-2.0
#
# Unless required by applicable law or agreed to in writing, software
# distributed under the License is distributed on an "AS IS" BASIS,
# WITHOUT WARRANTIES OR CONDITIONS OF ANY KIND, either express or implied.
# See the License for the specific language governing permissions and
# limitations under the License.
#

if SOC_STM32F446RE

config NUM_IRQS
	int
	default 112

config SRAM_SIZE
	default 128

config FLASH_SIZE
	default 512

endif #SOC_STM32F446RE
```

## boards/carbon/Kconfig.board
```kconfig
config  BOARD_CARBON
	bool "Carbon"
	select SOC_STM32F401RE
	depends on SOC_SERIES_STM32F4X
```

## boards/carbon/carbon_defconfig
```kconfig
CONFIG_ARM=y
CONFIG_BOARD_CARBON=y
CONFIG_SOC_STM32F401RE=y
CONFIG_SOC_SERIES_STM32F4X=y
CONFIG_SOC_STM32_CLOCK_HSI=y
CONFIG_CORTEX_M_SYSTICK=y
CONFIG_SYS_CLOCK_HW_CYCLES_PER_SEC=16000000
```

## boards/nrf51_pca10028/nrf51_pca10028_defconfig
```kconfig
CONFIG_ARM=y
CONFIG_BOARD_NRF51_PCA10028=y
CONFIG_SOC_FAMILY_NRF5=y
CONFIG_SOC_SERIES_NRF51X=y
CONFIG_FLASH_SIZE=256
CONFIG_SRAM_SIZE=32
CONFIG_XIP=y

# enable uart driver
CONFIG_SERIAL=y
CONFIG_UART_NRF5=y
CONFIG_UART_NRF5_GPIO_TX_PIN=9
CONFIG_UART_NRF5_GPIO_RX_PIN=11

# enable console
CONFIG_CONSOLE=y
CONFIG_UART_CONSOLE=y

# bluetooth
CONFIG_BLUETOOTH=y
CONFIG_BLUETOOTH_CONTROLLER=y
```

## boards/nrf52_pca10040/nrf52_pca10040_defconfig
```kconfig
CONFIG_ARM=y
CONFIG_SOC_SERIES_NRF52X=y
CONFIG_BOARD_NRF52_PCA10040=y

# enable uart driver
CONFIG_SERIAL=y
CONFIG_UART_NRF5=y

# enable console
CONFIG_CONSOLE=y
CONFIG_UART_CONSOLE=y

# additional board options
CONFIG_GPIO_AS_PINRESET=y

# bluetooth
CONFIG_BLUETOOTH=y
CONFIG_BLUETOOTH_CONTROLLER=y

# spi
CONFIG_SPI=y
CONFIG_SPI_SLAVE=y
CONFIG_SPI_0=y
CONFIG_SPI_0_NAME="SPI_0"
CONFIG_SPI_0_IRQ_PRI=2
CONFIG_SPI_NRF5=y
CONFIG_SPI_0_NRF5_GPIO_CS=22
CONFIG_SPI_0_NRF5_GPIO_SCK=25
CONFIG_SPI_0_NRF5_GPIO_MOSI=23
CONFIG_SPI_0_NRF5_GPIO_MISO=24
```

## boards/nucleo_f446re/Kconfig
```kconfig
if BOARD_NUCLEO_446RE

config BOARD
        default nucleo_446re

config SOC_STM32_CLOCK_HSI
       bool
       default y

endif # BOARD_NUCLEO_446RE
```

## boards/nucleo_f446re/Kconfig.board
```kconfig
config  BOARD_NUCLEO_446RE
        bool "ST NUCLEO-446RE Board"
        select SOC_STM32F4X
	depends on ARM
```

## boards/nucleo_f446re/nucleo_f446re_defconfig
```kconfig
CONFIG_ARM=y
CONFIG_BOARD_NUCLEO_F446RE=y
CONFIG_SOC_STM32F466RE=y
CONFIG_SOC_SERIES_STM32F4X=y
CONFIG_SOC_STM32_CLOCK_HSI=y
CONFIG_CORTEX_M_SYSTICK=y
CONFIG_SYS_CLOCK_HW_CYCLES_PER_SEC=16000000
```
