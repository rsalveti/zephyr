## prj.conf
```kconfig
CONFIG_FLASH=y
CONFIG_NETWORKING=y
CONFIG_NET_TCP=y
CONFIG_NET_CONTEXT_SYNC_RECV=n
CONFIG_NET_L2_BLUETOOTH=y
CONFIG_NET_IF_UNICAST_IPV6_ADDR_COUNT=3
CONFIG_NET_IF_MCAST_IPV6_ADDR_COUNT=2
CONFIG_NET_MAX_CONTEXTS=5
CONFIG_NET_RX_STACK_SIZE=2048
CONFIG_NET_NBUF_RX_COUNT=4
CONFIG_NET_NBUF_TX_COUNT=4
CONFIG_BLUETOOTH_HCI=y
CONFIG_BLUETOOTH_SPI_TRANSPORT=y
CONFIG_BLUETOOTH_DEBUG_LOG=y
CONFIG_BLUETOOTH_RX_BUF_COUNT=20
CONFIG_BLUETOOTH_RX_BUF_LEN=1024
CONFIG_MINIMAL_LIBC_EXTENDED=y
CONFIG_HTTP_PARSER=y

# Debug helpers
#CONFIG_NET_LOG=y
#CONFIG_SYS_LOG_NET_LEVEL=4
#CONFIG_NET_DEBUG_CORE=y
#CONFIG_NET_DEBUG_IF=y
#CONFIG_NET_DEBUG_UTILS=y
#CONFIG_NET_DEBUG_CONTEXT=y
#CONFIG_NET_DEBUG_NET_BUF=y
#CONFIG_NET_DEBUG_CONN=y
#CONFIG_NET_DEBUG_ROUTE=y
#CONFIG_NET_DEBUG_IPV6=y
#CONFIG_NET_DEBUG_ICMPV6=y
#CONFIG_NET_DEBUG_IPV6_NBR_CACHE=y
#CONFIG_NET_DEBUG_6LO=y
#CONFIG_NET_DEBUG_TCP=y
#CONFIG_NET_DEBUG_L2_BLUETOOTH=y
#CONFIG_BLUETOOTH_DEBUG_HCI_DRIVER=y
#CONFIG_INIT_STACKS=y
```

## prj_nrf52.conf
```kconfig
CONFIG_FLASH=y
CONFIG_NETWORKING=y
CONFIG_NET_TCP=y
CONFIG_NET_CONTEXT_SYNC_RECV=n
CONFIG_NET_L2_BLUETOOTH=y
CONFIG_NET_IF_UNICAST_IPV6_ADDR_COUNT=3
CONFIG_NET_IF_MCAST_IPV6_ADDR_COUNT=2
CONFIG_NET_MAX_CONTEXTS=5
CONFIG_NET_RX_STACK_SIZE=2048
CONFIG_NET_NBUF_RX_COUNT=4
CONFIG_NET_NBUF_TX_COUNT=4
CONFIG_BLUETOOTH_DEBUG_LOG=y
CONFIG_BLUETOOTH_RX_BUF_COUNT=20
CONFIG_BLUETOOTH_RX_BUF_LEN=1024
CONFIG_MINIMAL_LIBC_EXTENDED=y
CONFIG_HTTP_PARSER=y

# NRF52
CONFIG_FLASH_BASE_ADDRESS=0x00008020
CONFIG_SOC_FLASH_NRF5=y

# Debug helpers
#CONFIG_NET_LOG=y
#CONFIG_SYS_LOG_NET_LEVEL=4
#CONFIG_NET_DEBUG_CORE=y
#CONFIG_NET_DEBUG_IF=y
#CONFIG_NET_DEBUG_UTILS=y
#CONFIG_NET_DEBUG_CONTEXT=y
#CONFIG_NET_DEBUG_NET_BUF=y
#CONFIG_NET_DEBUG_CONN=y
#CONFIG_NET_DEBUG_ROUTE=y
#CONFIG_NET_DEBUG_IPV6=y
#CONFIG_NET_DEBUG_ICMPV6=y
#CONFIG_NET_DEBUG_IPV6_NBR_CACHE=y
#CONFIG_NET_DEBUG_6LO=y
#CONFIG_NET_DEBUG_TCP=y
#CONFIG_NET_DEBUG_L2_BLUETOOTH=y
#CONFIG_BLUETOOTH_DEBUG_HCI_DRIVER=y
#CONFIG_INIT_STACKS=y
```

## prj_stm32f4.conf
```kconfig
CONFIG_FLASH=y
CONFIG_NETWORKING=y
CONFIG_NET_TCP=y
CONFIG_NET_CONTEXT_SYNC_RECV=n
CONFIG_NET_L2_BLUETOOTH=y
CONFIG_NET_IF_UNICAST_IPV6_ADDR_COUNT=3
CONFIG_NET_IF_MCAST_IPV6_ADDR_COUNT=2
CONFIG_NET_MAX_CONTEXTS=5
CONFIG_NET_RX_STACK_SIZE=2048
CONFIG_NET_NBUF_RX_COUNT=4
CONFIG_NET_NBUF_TX_COUNT=4
CONFIG_BLUETOOTH_HCI=y
CONFIG_BLUETOOTH_SPI_TRANSPORT=y
CONFIG_BLUETOOTH_DEBUG_LOG=y
CONFIG_BLUETOOTH_RX_BUF_COUNT=20
CONFIG_BLUETOOTH_RX_BUF_LEN=1024
CONFIG_MINIMAL_LIBC_EXTENDED=y
CONFIG_HTTP_PARSER=y
CONFIG_TEST_RANDOM_GENERATOR=y

# STM32F4 (Nucleo, Carbon)
CONFIG_SOC_FLASH_STM32F4=y
CONFIG_FLASH_BASE_ADDRESS=0x08020020
CONFIG_XIP_ISR_RAM_RELOCATE=y

# Debug helpers
#CONFIG_NET_LOG=y
#CONFIG_SYS_LOG_NET_LEVEL=4
#CONFIG_NET_DEBUG_CORE=y
#CONFIG_NET_DEBUG_IF=y
#CONFIG_NET_DEBUG_UTILS=y
#CONFIG_NET_DEBUG_CONTEXT=y
#CONFIG_NET_DEBUG_NET_BUF=y
#CONFIG_NET_DEBUG_CONN=y
#CONFIG_NET_DEBUG_ROUTE=y
#CONFIG_NET_DEBUG_IPV6=y
#CONFIG_NET_DEBUG_ICMPV6=y
#CONFIG_NET_DEBUG_IPV6_NBR_CACHE=y
#CONFIG_NET_DEBUG_6LO=y
#CONFIG_NET_DEBUG_TCP=y
#CONFIG_NET_DEBUG_L2_BLUETOOTH=y
#CONFIG_BLUETOOTH_DEBUG_HCI_DRIVER=y
#CONFIG_INIT_STACKS=y
```

## src/main.c
```c
/*
 * Copyright (c) 2016 Linaro Limited
 *
 * Licensed under the Apache License, Version 2.0 (the "License");
 * you may not use this file except in compliance with the License.
 * You may obtain a copy of the License at
 *
 *     http://www.apache.org/licenses/LICENSE-2.0
 *
 * Unless required by applicable law or agreed to in writing, software
 * distributed under the License is distributed on an "AS IS" BASIS,
 * WITHOUT WARRANTIES OR CONDITIONS OF ANY KIND, either express or implied.
 * See the License for the specific language governing permissions and
 * limitations under the License.
 *
 */

#include <stdint.h>
#include <stddef.h>
#include <string.h>
#include <errno.h>
#include <misc/printk.h>
#include <misc/byteorder.h>
#include <misc/nano_work.h>
#include <gpio.h>
#include <flash.h>
#include <zephyr.h>

#include <bluetooth/bluetooth.h>
#include <bluetooth/hci.h>
#include <bluetooth/conn.h>
#include <bluetooth/uuid.h>
#include <misc/stack.h>

#include <soc.h>

#include <tc_util.h>

/* Local helpers and functions */
#include "bt_storage.h"
#include "bt_ipss.h"
#include "ota_debug.h"
#include "boot_utils.h"
#include "hawkbit.h"
#include "device.h"
#include "tcp.h"

#define STACKSIZE 2560
char threadStack[STACKSIZE];

#define MAX_POLL_FAIL	5
int poll_sleep = K_SECONDS(15);
struct device *flash_dev;

static bool bt_connection_state = false;

/* BT LE Connect/Disconnect callbacks */
static void connected(struct bt_conn *conn, uint8_t err)
{
	if (err) {
		printk("BT LE Connection failed (err %u)\n", err);
	} else {
		printk("BT LE Connected\n");
		bt_connection_state = true;
		set_bluetooth_led(1);
	}
}

static void disconnected(struct bt_conn *conn, uint8_t reason)
{
	printk("BT LE Disconnected (reason %u), rebooting!\n", reason);
	set_bluetooth_led(0);
	sys_arch_reboot(0);
}

static struct bt_conn_cb conn_callbacks = {
	.connected = connected,
	.disconnected = disconnected,
};

/* Firmware OTA thread (Hawkbit) */
static void fota_service(void)
{
	uint32_t failed_poll = 0;
	uint32_t acid;
	int ret;

	OTA_INFO("Starting FOTA Service Thread\n");

	flash_dev = device_get_binding(FLASH_DRIVER_NAME);
	if (!flash_dev) {
		OTA_ERR("Failed to find the flash driver\n");
		TC_END_RESULT(TC_FAIL);
		TC_END_REPORT(TC_FAIL);
		return;
	}

	/* Update boot status and acid */
	acid = boot_acid_read(BOOT_ACID_UPDATE);
	if (boot_status_read() == 0xff) {
		boot_status_update();
		boot_erase_flash_bank(FLASH_BANK1_OFFSET);
		if (acid != -1) {
			boot_acid_update(BOOT_ACID_CURRENT, acid);
		}
	}

	TC_END_RESULT(TC_PASS);

	do {
		k_sleep(poll_sleep);
		if (!bt_connection_state) {
			OTA_DBG("No BT LE connection\n");
			continue;
		}

		ret = hawkbit_ddi_poll();
		if (ret < 0) {
			if (ret != -EBUSY) {
				failed_poll++;
				OTA_DBG("Failed poll attempt %d\n\n\n", failed_poll);
			}
			else {
				OTA_DBG("Skipping poll attempt\n\n\n");
			}
			if (failed_poll == MAX_POLL_FAIL) {
				printk("Too many unsuccessful poll attempts,"
						" rebooting!\n");
				sys_arch_reboot(0);
			}
		} else {
			/* restart the failed attempt counter */
			failed_poll = 0;
		}

		stack_analyze("FOTA Thread", threadStack, STACKSIZE);
	} while (1);
}

void blink_led(void)
{
	uint32_t cnt = 0;
	struct device *gpio;

	gpio = device_get_binding(GPIO_DRV_NAME);
	gpio_pin_configure(gpio, LED_BLINK, GPIO_DIR_OUT);

	while (1) {
		gpio_pin_write(gpio, LED_BLINK, cnt % 2);
		k_sleep(K_SECONDS(1));
                if (cnt == 1) {
                        TC_END_RESULT(TC_PASS);
                        TC_END_REPORT(TC_PASS);
                }
		cnt++;
	}
}

void main(void)
{
	int err;

	set_device_id();

	printk("Linaro FOTA example application\n");
	printk("Device: %s, Serial: %x\n", product_id.name, product_id.number);

	TC_START("Running Built in Self Test (BIST)");

	/* Storage used to provide a BT MAC based on the serial number */
	TC_PRINT("Setting Bluetooth MAC\n");
	bt_storage_init();

	TC_PRINT("Enabling Bluetooth\n");
	err = bt_enable(NULL);
	if (err) {
		printk("ERROR: Bluetooth init failed (err %d)\n", err);
		TC_END_RESULT(TC_FAIL);
		TC_END_REPORT(TC_FAIL);
		return;
	}
	else {
		TC_END_RESULT(TC_PASS);
	}

	/* Callbacks for BT LE connection state */
	TC_PRINT("Registering Bluetooth LE connection callbacks\n");
	ipss_init(&conn_callbacks);

	TC_PRINT("Advertising Bluetooth IP Profile\n");
	err = ipss_advertise();
	if (err) {
		printk("ERROR: Advertising failed to start (err %d)\n", err);
		return;
	}

	TC_PRINT("Starting the FOTA Service\n");
	k_thread_spawn(&threadStack[0], STACKSIZE,
			(k_thread_entry_t) fota_service,
			NULL, NULL, NULL, K_PRIO_COOP(7), 0, K_NO_WAIT);

	TC_PRINT("Blinking LED\n");
	blink_led();
}
```

## src/hawkbit.c
```c
/*
 * Copyright (c) 2016 Linaro Limited
 *
 * Licensed under the Apache License, Version 2.0 (the "License");
 * you may not use this file except in compliance with the License.
 * You may obtain a copy of the License at
 *
 *     http://www.apache.org/licenses/LICENSE-2.0
 *
 * Unless required by applicable law or agreed to in writing, software
 * distributed under the License is distributed on an "AS IS" BASIS,
 * WITHOUT WARRANTIES OR CONDITIONS OF ANY KIND, either express or implied.
 * See the License for the specific language governing permissions and
 * limitations under the License.
 *
 */

#include <stdint.h>
#include <stddef.h>
#include <string.h>
#include <errno.h>
#include <misc/byteorder.h>
#include <flash.h>
#include <zephyr.h>

#include <bluetooth/bluetooth.h>

#include <soc.h>
#include <net/http_parser.h>

#include "ota_debug.h"
#include "jsmn.h"
#include "hawkbit.h"
#include "tcp.h"
#include "boot_utils.h"
#include "device.h"

#define BUF_SIZE 1024
uint8_t tcp_buf[BUF_SIZE];

struct json_data_t {
	char *data;
	size_t len;
};

struct http_download_t {
	size_t header_size;
	size_t content_length;
};

typedef enum {
	HAWKBIT_UPDATE_SKIP = 0,
	HAWKBIT_UPDATE_ATTEMPT,
	HAWKBIT_UPDATE_FORCED
} hawkbit_update_action_t;

typedef enum {
	HAWKBIT_RESULT_SUCCESS = 0,
	HAWKBIT_RESULT_FAILURE,
	HAWKBIT_RESULT_NONE,
} hawkbit_result_status_t;

typedef enum {
	HAWKBIT_EXEC_CLOSED = 0,
	HAWKBIT_EXEC_PROCEEDING,
	HAWKBIT_EXEC_CANCELED,
	HAWKBIT_EXEC_SCHEDULED,
	HAWKBIT_EXEC_REJECTED,
	HAWKBIT_EXEC_RESUMED,
} hawkbit_exec_status_t;

/* Utils */
static int atoi_n(const char *s, int len)
{
        int i, val = 0;

	for (i = 0; i < len; i++) {
		if (*s < '0' || *s > '9')
			return val;
		val = (val * 10) + (*s - '0');
		s++;
	}

        return val;
}

static int jsoneq(const char *json, jsmntok_t *tok, const char *s)
{
	if (tok->type == JSMN_STRING &&
		(int) strlen(s) == tok->end - tok->start &&
		strncmp(json + tok->start, s, tok->end - tok->start) == 0) {
		return 1;
	}
	return 0;
}

static int json_parser(struct json_data_t *json, jsmn_parser *parser,
		       jsmntok_t *tks, uint16_t num_tokens)
{
	int ret = 0;

	OTA_DBG("JSON: max tokens supported %d\n", num_tokens);

	jsmn_init(parser);
	ret = jsmn_parse(parser, json->data, json->len, tks, num_tokens);
	if (ret < 0) {
		switch (ret) {
		case JSMN_ERROR_NOMEM:
			OTA_DBG("JSON: Not enough tokens\n");
			break;
		case JSMN_ERROR_INVAL:
			OTA_DBG("JSON: Invalid character found\n");
			break;
		case JSMN_ERROR_PART:
			OTA_DBG("JSON: Incomplete JSON\n");
			break;
		}
		return ret;
	} else if (ret == 0 || tks[0].type != JSMN_OBJECT) {
		OTA_DBG("JSON: First token is not an object\n");
		return 0;
	}

	OTA_DBG("JSON: %d tokens found\n", ret);

	return ret;
}

static int hawkbit_time2sec(const char *s)
{
        int sec = 0;

	/* Time: HH:MM:SS */
	sec = atoi_n(s, 2) * 60 * 60;
	sec += atoi_n(s + 3, 2) * 60;
	sec += atoi_n(s + 6, 2);

	if (sec < 0) {
		return -1;
	} else {
		return sec;
	}
}

/* HTTP parser callbacks */
static int handle_headers_complete(struct http_parser *parser)
{
	/* Check if our buffer is enough for a valid body */
	if (parser->nread + parser->content_length >= BUF_SIZE) {
		OTA_ERR("header + body larger than buffer %d\n", BUF_SIZE);
		return -1;
	}
	return 0;
}

static int handle_http_body(struct http_parser* parser, const char *at, size_t len)
{
	struct json_data_t *json = parser->data;

	if (json) {
		json->data = (char *) at;
		json->len = len;
	}

	return 0;
}

static int handle_headers_complete_download(struct http_parser *parser)
{
	struct http_download_t *http_data = parser->data;

	if (parser->status_code == 200) {
		http_data->header_size = parser->nread;
		http_data->content_length = parser->content_length;
	}

	return 1;
}

static int hawkbit_install_update(uint8_t *tcp_buffer, size_t size,
				  const char *download_http,
				  size_t file_size)
{
	struct http_parser_settings http_settings;
	struct http_download_t http_data = { 0 };
	struct http_parser parser;
	int downloaded_size = 0;
	int ret, len;

	if (!tcp_buffer || !download_http || !file_size) {
		return -EINVAL;
	}

	if (flash_erase(flash_dev, FLASH_BANK1_OFFSET, FLASH_BANK_SIZE) != 0) {
		OTA_ERR("Failed to erase flash at offset %x, size %d\n",
					FLASH_BANK1_OFFSET, FLASH_BANK_SIZE);
		return -EIO;
	}

	http_parser_init(&parser, HTTP_RESPONSE);
	http_parser_settings_init(&http_settings);
	http_settings.on_headers_complete = handle_headers_complete_download;
	parser.data = &http_data;

	OTA_INFO("Starting the download and flash process\n");

	/* Here we just proceed with a normal HTTP Download process */
	memset(tcp_buffer, 0, size);
	snprintf(tcp_buffer, size, "GET %s HTTP/1.1\r\n"
				"Host: %s\r\n"
				"Connection: close\r\n"
				"\r\n",
				download_http, HAWKBIT_HOST);

	ret = tcp_send((const char *) tcp_buffer, strlen(tcp_buffer));
	if (ret < 0) {
		OTA_ERR("Failed to send buffer, err %d\n", ret);
		return ret;
	}

	/* Receive is special for download, since it writes to flash */
	memset(tcp_buf, 0, BUF_SIZE);
	len = tcp_recv((char *) tcp_buffer, size, TCP_RX_TIMEOUT);
	if (len <= 0) {
		OTA_ERR("Unable to start the download process (ret=%d)\n", len);
		return -1;
	}

	/* Parse the HTTP headers available from the first buffer */
	http_parser_execute(&parser, &http_settings,
				(const char *) tcp_buffer, size);
	if (parser.status_code != 200) {
		OTA_ERR("Download: http error %d\n", parser.status_code);
		return -1;
	}
	if (http_data.content_length != file_size) {
		OTA_ERR("Download: file size not the same as reported, "
				"found %d, expecting %d\n",
				http_data.content_length, file_size);
		return -1;
	}

	/* Everything looks good, so fetch and flash */
	flash_write_protection_set(flash_dev, false);

	if (len > http_data.header_size) {
		len -= http_data.header_size;
		flash_write(flash_dev, FLASH_BANK1_OFFSET,
				tcp_buffer + http_data.header_size,
				len);
		downloaded_size += len;
	}

	while (true) {
		len = tcp_recv((char *) tcp_buffer, size, TCP_RX_TIMEOUT);
		if (len <= 0) {
			if (len < 0) {
				OTA_ERR("Download error recieved: %d", len);
				return -1;
			}
			break;
		}
		flash_write(flash_dev, FLASH_BANK1_OFFSET + downloaded_size,
							tcp_buffer, len);
		downloaded_size += len;
	}
	flash_write_protection_set(flash_dev, true);

	if (downloaded_size != file_size) {
		OTA_ERR("Download: downloaded image size mismatch, "
				"downloaded %d, expecting %d\n",
				downloaded_size, file_size);
		return -1;
	}

	OTA_INFO("Download: downloaded bytes %d\n", downloaded_size);

	return 0;
}

static int hawkbit_query(uint8_t *tcp_buffer, size_t size,
			 struct json_data_t *json)
{
	struct http_parser_settings http_settings;
	struct http_parser parser;
	int ret;

	if (!tcp_buffer) {
		return -EINVAL;
	}

	OTA_DBG("\n\n%s\n", tcp_buffer);

	ret = tcp_send((const char *) tcp_buffer, strlen(tcp_buffer));
	if (ret < 0) {
		OTA_ERR("Failed to send buffer, err %d\n", ret);
		return ret;
	}
	ret = tcp_recv((char *) tcp_buffer, size, K_FOREVER);
	if (ret <= 0) {
		OTA_ERR("No received data (ret=%d)\n", ret);
		return -1;
	}
	tcp_buffer[ret] = '\0';

	http_parser_init(&parser, HTTP_RESPONSE);
	http_parser_settings_init(&http_settings);
	http_settings.on_body = handle_http_body;
	http_settings.on_headers_complete = handle_headers_complete;
	parser.data = json;

	http_parser_execute(&parser, &http_settings,
				(const char *) tcp_buffer, size);
	if (parser.status_code != 200) {
		OTA_ERR("Invalid HTTP status code %d\n",
						parser.status_code);
		return -1;
	}

	if (json) {
		if (json->data == NULL) {
			OTA_ERR("JSON data not found\n");
			return -1;
		}
		/* FIXME: Each poll needs a new connection, this saves
		 * us from using content from a previous package.
		 */
		json->data[json->len] = '\0';
		OTA_DBG("JSON DATA:\n%s\n", json->data);
	}

	OTA_DBG("Hawkbit query completed\n");

	return 0;
}

static int hawkbit_report_config_data(uint8_t *tcp_buffer, size_t size)
{
	char *helper;

	OTA_INFO("Reporting target config data to Hawkbit\n");

	/* Use half for the header and half for the json content */
	memset(tcp_buffer, 0, size);
	helper = tcp_buffer + size / 2;

	/* Start with JSON as we need to calculate the content length */
	snprintf(helper, size / 2, "{"
			"\"data\":{"
				"\"board\":\"%s\","
				"\"serial\":\"%x\"},"
			"\"status\":{"
				"\"result\":{\"finished\":\"success\"},"
				"\"execution\":\"closed\"}"
			"}", product_id.name, product_id.number);

	/* size / 2 should be enough for the header */
	snprintf(tcp_buffer, size, "PUT %s/%s-%x/configData HTTP/1.1\r\n"
			"Host: %s\r\n"
			"Content-Type: application/json\r\n"
			"Content-Length: %d\r\n"
			"Connection: close\r\n"
			"\r\n%s", HAWKBIT_JSON_URL,
			product_id.name, product_id.number,
			HAWKBIT_HOST, strlen(helper), helper);

	if (hawkbit_query(tcp_buffer, size, NULL) < 0) {
		OTA_ERR("Error when reporting config data to Hawkbit\n");
		return -1;
	}

	return 0;
}

static int hawkbit_report_update_status(int acid,
					uint8_t *tcp_buffer, size_t size,
					hawkbit_result_status_t status,
					hawkbit_exec_status_t exec)
{
	char finished[8];	/* 'success', 'failure', 'none' */
	char execution[11];
	char *helper;

	switch (status) {
	case HAWKBIT_RESULT_SUCCESS:
		snprintf(finished, sizeof(finished), "success");
		break;
	case HAWKBIT_RESULT_FAILURE:
		snprintf(finished, sizeof(finished), "failure");
		break;
	case HAWKBIT_RESULT_NONE:
		snprintf(finished, sizeof(finished), "none");
		break;
	}

	/* 'closed', 'proceeding', 'canceled', 'scheduled',
	 * 'rejected', 'resumed'
	 */
	switch (exec) {
	case HAWKBIT_EXEC_CLOSED:
		snprintf(execution, sizeof(execution), "closed");
		break;
	case HAWKBIT_EXEC_PROCEEDING:
		snprintf(execution, sizeof(execution), "proceeding");
		break;
	case HAWKBIT_EXEC_CANCELED:
		snprintf(execution, sizeof(execution), "canceled");
		break;
	case HAWKBIT_EXEC_SCHEDULED:
		snprintf(execution, sizeof(execution), "scheduled");
		break;
	case HAWKBIT_EXEC_REJECTED:
		snprintf(execution, sizeof(execution), "rejected");
		break;
	case HAWKBIT_EXEC_RESUMED:
		snprintf(execution, sizeof(execution), "resumed");
		break;
	}

	OTA_INFO("Reporting action ID feedback: %s\n", finished);

	/* Use half for the header and half for the json content */
	memset(tcp_buffer, 0, size);
	helper = tcp_buffer + size / 2;

	/* Start with JSON as we need to calculate the content length */
	snprintf(helper, size / 2, "{"
			"\"id\":\"%d\","
			"\"status\":{"
				"\"result\":{\"finished\":\"%s\"},"
				"\"execution\":\"%s\"}"
			"}", acid, finished, execution);

	/* size / 2 should be enough for the header */
	snprintf(tcp_buffer, size,
			"POST %s/%s-%x/deploymentBase/%d/feedback HTTP/1.1\r\n"
			"Host: %s\r\n"
			"Content-Type: application/json\r\n"
			"Content-Length: %d\r\n"
			"Connection: close\r\n"
			"\r\n%s", HAWKBIT_JSON_URL,
			product_id.name, product_id.number, acid,
			HAWKBIT_HOST, strlen(helper), helper);

	if (hawkbit_query(tcp_buffer, size, NULL) < 0) {
		OTA_ERR("Error when reporting acId feedback to Hawkbit\n");
		return -1;
	}

	return 0;
}

int hawkbit_ddi_poll(void)
{
	jsmn_parser jsmnp;
	jsmntok_t jtks[60];	/* Enough for one artifact per SM */
	int i, ret, len, ntk;
	static hawkbit_update_action_t hawkbit_update_action;
	static int hawkbit_acid = 0;
	struct json_data_t json = { NULL, 0 };
	char deployment_base[40];	/* TODO: Find a better value */
	char download_http[200];	/* TODO: Find a better value */
	bool update_config_data = false;
	bool action_sleep = false;
	int file_size = 0;
	char *helper;

	OTA_DBG("Polling target data from Hawkbit\n");

	memset(tcp_buf, 0, BUF_SIZE);
	snprintf(tcp_buf, BUF_SIZE, "GET %s/%s-%x HTTP/1.1\r\n"
				"Host: %s\r\n"
				"Connection: close\r\n"
				"\r\n",
				HAWKBIT_JSON_URL,
				product_id.name, product_id.number,
				HAWKBIT_HOST);

	ret = hawkbit_query(tcp_buf, BUF_SIZE, &json);
	if (ret < 0) {
		OTA_ERR("Error when polling from Hawkbit\n");
		return ret;
	}

	ntk = json_parser(&json, &jsmnp, jtks,
			sizeof(jtks) / sizeof(jsmntok_t));
	if (ntk <= 0) {
		OTA_ERR("Error when parsing JSON from target\n");
		return -1;
	}

	/* Hawkbit DDI v1 targetid */
	memset(deployment_base, 0, sizeof(deployment_base));
	/* TODO: Implement cancel action logic */
	for (i = 1; i < ntk - 1; i++) {
		/* config -> polling -> sleep */
		if (jsoneq(json.data, &jtks[i], "config") &&
				(i + 5 < ntk) &&
				(jsoneq(json.data, &jtks[i + 4], "sleep"))) {
			/* Sleep format: HH:MM:SS */
			if (jtks[i + 5].end - jtks[i + 5].start > 8) {
				OTA_ERR("Invalid poll sleep string\n");
				continue;
			}
			len = hawkbit_time2sec(json.data + jtks[i + 5].start);
			if (len > 0) {
				if (poll_sleep != K_SECONDS(len)) {
					OTA_INFO("New poll sleep %d seconds\n", len);
					poll_sleep = K_SECONDS(len);
				}
				action_sleep = true;
				i += 5;
			}
		} else if (jsoneq(json.data, &jtks[i], "deploymentBase") &&
				(i + 3 < ntk) &&
				(jsoneq(json.data, &jtks[i + 2], "href"))) {
			/* Just extract the deploymentBase piece */
			helper = strstr(json.data + jtks[i + 3].start,
							"deploymentBase/");
			if (helper == NULL ||
					helper > json.data + jtks[i + 3].end) {
				continue;
			}
			len = json.data + jtks[i + 3].end - helper;
			memcpy(&deployment_base, helper, len);
			deployment_base[len] = '\0';
			OTA_DBG("Deployment base %s\n", deployment_base);
			i += 3;
		} else if (jsoneq(json.data, &jtks[i], "configData") &&
				(i + 3 < ntk) &&
				(jsoneq(json.data, &jtks[i + 2], "href"))) {
			update_config_data = true;
			i += 3;
		}
	}

	if (action_sleep)
		return 0;

	/* Update config data if the server asked for it */
	if (update_config_data) {
		hawkbit_report_config_data(tcp_buf, BUF_SIZE);
	}

	if (strlen(deployment_base) == 0) {
		OTA_DBG("No deployment base found, no actions to take\n");
		return 0;
	}

	/* Hawkbit DDI v1 deploymentBase */
	memset(tcp_buf, 0, BUF_SIZE);
	snprintf(tcp_buf, BUF_SIZE, "GET %s/%s-%x/%s HTTP/1.1\r\n"
				"Host: %s\r\n"
				"Connection: close\r\n"
				"\r\n",
				HAWKBIT_JSON_URL,
				product_id.name, product_id.number,
				deployment_base, HAWKBIT_HOST);

	memset(&json, 0, sizeof(struct json_data_t));
	if (hawkbit_query(tcp_buf, BUF_SIZE, &json) < 0) {
		OTA_ERR("Error when querying from Hawkbit\n");
		return -1;
	}

	/* We have our own limit here, which is directly affected by the
	 * number of artifacts available as part of the software module
	 * assigned, so needs coordination with the deployment process.
	 */
	ntk = json_parser(&json, &jsmnp, jtks,
			sizeof(jtks) / sizeof(jsmntok_t));
	if (ntk <= 0) {
		OTA_ERR("Error when parsing JSON from deploymentBase\n");
		return -1;
	}

	ret = 0;
	memset(download_http, 0, sizeof(download_http));
	for (i = 1; i < ntk - 1; i++) {
		if (jsoneq(json.data, &jtks[i], "id")) {
			/* id -> id */
			hawkbit_acid = atoi_n(json.data + jtks[i + 1].start,
					jtks[i + 1].end - jtks[i + 1].start);
			OTA_DBG("Hawkbit ACTION ID %d\n", hawkbit_acid);
			i += 1;
		} else if (jsoneq(json.data, &jtks[i], "deployment")) {
			/* deployment -> download, update or chunks */
			if (i + 5 >= ntk) {
				continue;
			}
			/* Check just the first 2 keys, since chunk is [] */
			if (jsoneq(json.data, &jtks[i + 2], "update")) {
				i += 3;
			} else if (jsoneq(json.data, &jtks[i + 4], "update")) {
				i += 5;
			} else {
				continue;
			}
			/* Now just find the update action */
			if (jsoneq(json.data, &jtks[i], "skip")) {
				hawkbit_update_action = HAWKBIT_UPDATE_SKIP;
				OTA_DBG("Hawkbit update action: SKIP\n");
			} else if (jsoneq(json.data, &jtks[i], "attempt")) {
				hawkbit_update_action = HAWKBIT_UPDATE_ATTEMPT;
				OTA_DBG("Hawkbit update action: ATTEMPT\n");
			} else if (jsoneq(json.data, &jtks[i], "forced")) {
				hawkbit_update_action = HAWKBIT_UPDATE_FORCED;
				OTA_DBG("Hawkbit update action: FORCED\n");
			}
		} else if (jsoneq(json.data, &jtks[i], "chunks")) {
			if (jtks[i + 1].type != JSMN_ARRAY) {
				continue;
			}
			if (jtks[i + 1].size != 1) {
				OTA_ERR("Only one chunk is supported, %d\n",
							jtks[i + 1].size);
				ret = -1;
				break;
			}
			i += 1;
		} else if (jsoneq(json.data, &jtks[i], "part")) {
			if (!jsoneq(json.data, &jtks[i + 1], "os")) {
				OTA_ERR("Only part 'os' is supported\n");
				ret = -1;
				break;
			}
			i += 1;
		} else if (jsoneq(json.data, &jtks[i], "size")) {
			file_size = atoi_n(json.data + jtks[i + 1].start,
					jtks[i + 1].end - jtks[i + 1].start);
			OTA_DBG("Artifact file size: %d\n", file_size);
			i += 1;
		} else if (jsoneq(json.data, &jtks[i], "download-http")) {
			/* We just support DEFAULT tenant on the same server */
			if (i + 3 >= ntk ||
				!jsoneq(json.data, &jtks[i + 2], "href")) {
				OTA_ERR("No href entry for download-http\n");
				ret = -1;
				continue;
			}
			/* Extracting everying after server address */
			helper = strstr(json.data + jtks[i + 3].start,
						"/DEFAULT/controller/v1");
			if (helper == NULL ||
					helper > json.data + jtks[i + 3].end) {
				continue;
			}
			len = json.data + jtks[i + 3].end - helper;
			if (len >= sizeof(download_http)) {
				OTA_ERR("Download HREF too big (%d)\n", len);
				ret = - 1;
				continue;
			}
			memcpy(&download_http, helper, len);
			download_http[len] = '\0';
			OTA_DBG("Artifact address: %s\n", download_http);
			i += 3;
		}
	}

	if (boot_acid_read(BOOT_ACID_CURRENT) == hawkbit_acid) {
		/* We are coming from a successful flash, update the server */
		hawkbit_report_update_status(hawkbit_acid,
					     tcp_buf, BUF_SIZE,
					     HAWKBIT_RESULT_SUCCESS,
					     HAWKBIT_EXEC_CLOSED);
		return 0;
	} else if (boot_acid_read(BOOT_ACID_UPDATE) == hawkbit_acid) {
		/* There was already an atempt, so announce a failure */
		hawkbit_report_update_status(hawkbit_acid,
					     tcp_buf, BUF_SIZE,
					     HAWKBIT_RESULT_FAILURE,
					     HAWKBIT_EXEC_CLOSED);
		return 0;
	}

	/* Perform the action */
	if (strlen(download_http) == 0) {
		OTA_DBG("No download http address found, no action\n");
		return 0;
	}
	/* Error detected when parsing the SM */
	if (ret == -1) {
		hawkbit_report_update_status(hawkbit_acid,
					     tcp_buf, BUF_SIZE,
					     HAWKBIT_RESULT_FAILURE,
					     HAWKBIT_EXEC_CLOSED);
		return -1;
	}
	if (file_size > FLASH_BANK_SIZE) {
		OTA_ERR("Artifact file size too big (%d)\n", file_size);
		hawkbit_report_update_status(hawkbit_acid,
					     tcp_buf, BUF_SIZE,
					     HAWKBIT_RESULT_FAILURE,
					     HAWKBIT_EXEC_CLOSED);
		return -1;
	}

	/* Here we should have everything we need to apply the action */
	OTA_INFO("Valid action ID %d found, proceeding with the update\n",
					hawkbit_acid);
	hawkbit_report_update_status(hawkbit_acid,
				     tcp_buf, BUF_SIZE,
				     HAWKBIT_RESULT_SUCCESS,
				     HAWKBIT_EXEC_PROCEEDING);
	ret = hawkbit_install_update(tcp_buf, BUF_SIZE, download_http, file_size);
	if (ret != 0) {
		OTA_ERR("Failed to install the update for action ID %d\n",
					hawkbit_acid);
		return -1;
	}

	boot_trigger_ota();
	boot_acid_update(BOOT_ACID_UPDATE, hawkbit_acid);
	OTA_INFO("Image id %d flashed successfuly, rebooting now\n",
					hawkbit_acid);

	/* Reboot and let the bootloader take care of the swap process */
	sys_arch_reboot(0);

	return 0;
}
```

## src/hawkbit.h
```c
/*
 * Copyright (c) 2016 Linaro Limited
 *
 * Licensed under the Apache License, Version 2.0 (the "License");
 * you may not use this file except in compliance with the License.
 * You may obtain a copy of the License at
 *
 *     http://www.apache.org/licenses/LICENSE-2.0
 *
 * Unless required by applicable law or agreed to in writing, software
 * distributed under the License is distributed on an "AS IS" BASIS,
 * WITHOUT WARRANTIES OR CONDITIONS OF ANY KIND, either express or implied.
 * See the License for the specific language governing permissions and
 * limitations under the License.
 *
 */

#define HAWKBIT_HOST	"gitci.com:8080"
#define HAWKBIT_IPADDR	{{{ 0xfc, 0x00, 0x00, 0x00, 0x00, 0x00, 0x00, 0x00, \
			    0xd4, 0xe7, 0x00, 0x00, 0x00, 0x00, 0x00, 0x01 }}}
#define HAWKBIT_PORT	8888
#define HAWKBIT_JSON_URL "/gitci/DEFAULT/controller/v1"

extern int poll_sleep;

/* TODO: Use the proper reboot Zephyr API instead (enabled via Kconfig) */
extern void sys_arch_reboot(int type);
int hawkbit_ddi_poll(void);
```

## src/tcp.c
```c
/*
 * Copyright (c) 2016 Linaro Limited
 *
 * Licensed under the Apache License, Version 2.0 (the "License");
 * you may not use this file except in compliance with the License.
 * You may obtain a copy of the License at
 *
 *     http://www.apache.org/licenses/LICENSE-2.0
 *
 * Unless required by applicable law or agreed to in writing, software
 * distributed under the License is distributed on an "AS IS" BASIS,
 * WITHOUT WARRANTIES OR CONDITIONS OF ANY KIND, either express or implied.
 * See the License for the specific language governing permissions and
 * limitations under the License.
 *
 */

#include <stdint.h>
#include <stddef.h>
#include <errno.h>
#include <zephyr.h>

#include <net/net_core.h>
#include <net/net_context.h>
#include <net/nbuf.h>
#include <net/net_if.h>

#include "ota_debug.h"
#include "tcp.h"
#include "hawkbit.h"

#define SERVER_CONNECT_TIMEOUT		K_SECONDS(5)
#define SERVER_CONNECT_MAX_WAIT_COUNT	2
#define TCP_TX_TIMEOUT			K_MSEC(500)

/* Global address to be set from RA */
static struct in6_addr client_addr = IN6ADDR_ANY_INIT;
static struct in6_addr server_addr = HAWKBIT_IPADDR;

#define CLIENT_PORT	5545
#define SERVER_PORT	HAWKBIT_PORT

static struct net_context *net_ctx = { 0 };

static bool tcp_inited = false;
static bool tcp_connected = false;
static int tcp_connect_wait_try = 0;
static struct k_sem sem_recv_wait;
static struct k_sem sem_recv_mutex;

#define TCP_BUF_SIZE 1024
static uint8_t tcp_read_buf[TCP_BUF_SIZE];
static uint16_t read_bytes = 0;

static void tcp_cleanup(bool put_context)
{
	if (put_context && net_ctx) {
		net_context_put(net_ctx);
	}
	net_ctx = NULL;
	tcp_connected = false;
	tcp_connect_wait_try = 0;
}

static void tcp_received_cb(struct net_context *context,
			    struct net_buf *buf, int status, void *user_data)
{
	ARG_UNUSED(context);
	ARG_UNUSED(user_data);
	struct net_buf *rx_buf;
	uint8_t *ptr;
	int len;

	/* handle FIN packet */
	if (!buf) {
		/* clear out our reference to the network connection */
		tcp_cleanup(false);
		k_sem_give(&sem_recv_wait);
	} else {
		k_sem_take(&sem_recv_mutex, K_FOREVER);
		/*
		 * TODO: if overflow, return an error and save
		 * the nbuf for later processing
		 */
		if (read_bytes + net_nbuf_appdatalen(buf) >= TCP_BUF_SIZE) {
			printk("tcp_received: ERROR buffer overflow! (read(%u)+bufflen(%u) >= %u)\n",
			       read_bytes, net_nbuf_appdatalen(buf), TCP_BUF_SIZE);
		} else {
			rx_buf = buf->frags;
			ptr = net_nbuf_appdata(buf);
			len = rx_buf->len - (ptr - rx_buf->data);

			while (rx_buf) {
				memcpy(tcp_read_buf + read_bytes, ptr, len);
				read_bytes += len;
				rx_buf = rx_buf->frags;
				if (!rx_buf) {
					break;
				}
				ptr = rx_buf->data;
				len = rx_buf->len;
			}
		}
		tcp_read_buf[read_bytes] = 0;
		k_sem_give(&sem_recv_mutex);
		net_nbuf_unref(buf);
	}
}

static int count_ipv6_unicast_addr(void)
{
	struct net_if *iface;
	int i;
	int count = 0;

	iface = net_if_get_default();
	if (iface) {
		for (i = 0; i < NET_IF_MAX_IPV6_ADDR; i++) {
			if (iface->ipv6.unicast[i].is_used &&
			    iface->ipv6.unicast[i].address.family == AF_INET6) {
				count++;
			}
		}
	}

	printk("DEBUG: count_ipv6_unicast_addr = %d\n", count);
	return count;
}

static void tcp_init(void)
{
	net_if_ipv6_addr_add(net_if_get_default(),
			     &client_addr, NET_ADDR_MANUAL, 0);

	k_sem_init(&sem_recv_wait, 0, 1);
	k_sem_init(&sem_recv_mutex, 1, 1);

	tcp_inited = true;
}

static void tcp_connect_cb(struct net_context *context, void *user_data)
{
	printk("IPv6 connect cb called\n");
	tcp_connected = true;
}

static int tcp_connect(void)
{
	struct sockaddr_in6 my_addr = { 0 };
	struct sockaddr_in6 dst_addr = { 0 };
	int rc;

	if (!tcp_inited)
		tcp_init();

	/* make sure we have a network context */
	if (!net_ctx)
	{
		rc = net_context_get(AF_INET6, SOCK_STREAM, IPPROTO_TCP, &net_ctx);
		if (rc < 0) {
			printk("Cannot get network context for IPv6 TCP (%d)\n", rc);
			net_ctx = NULL;
			return -EIO;
		}

		net_ipaddr_copy(&my_addr.sin6_addr, &client_addr);
		my_addr.sin6_family = AF_INET6;
		my_addr.sin6_port = htons(CLIENT_PORT);

		rc = net_context_bind(net_ctx, (struct sockaddr *)&my_addr,
				      sizeof(struct sockaddr_in6));
		if (rc < 0) {
			printk("Cannot bind IPv6 TCP port %d (%d)\n", CLIENT_PORT, rc);
			net_context_put(net_ctx);
			return -EINVAL;
		}
	}

	if (!net_ctx) {
		printk("ERROR: No TCP network context!\n");
		return -EIO;
	}

	/* if we're already connected return */
	if (net_context_get_state(net_ctx) == NET_CONTEXT_CONNECTED) {
		return 0;
	}

	if (!tcp_connected) {
		/* make sure we have RADV IP assignment (unicast #3) */
		if (count_ipv6_unicast_addr() < 3) {
			printk("WARNING: No RADV IPv6 assignment -- waiting.\n");
			return -EBUSY;
		}

		net_ipaddr_copy(&dst_addr.sin6_addr, &server_addr);
		dst_addr.sin6_family = AF_INET6;
		dst_addr.sin6_port = htons(SERVER_PORT);

		/* triggering the connection starts the callback sequence */
		rc = net_context_connect(net_ctx, (struct sockaddr *)&dst_addr,
					  sizeof(struct sockaddr_in6), tcp_connect_cb,
					  SERVER_CONNECT_TIMEOUT, NULL);
		if (rc < 0) {
			printk("Cannot connect to IPv6 server address (%d)\n", rc);
			return -EIO;
		}
	}
	else {
		tcp_connect_wait_try++;
		if (tcp_connect_wait_try == SERVER_CONNECT_MAX_WAIT_COUNT) {
			printk("WARNING: Connection was not ACKed -- MAX TRIES REACHED.\nResetting context!\n");
			tcp_cleanup(true);
		} else {
			printk("WARNING: Connection is not ACKed -- waiting [state=%d]\n", net_context_get_state(net_ctx));
		}
	}
	return -EBUSY;
}

int tcp_send(const unsigned char *buf, size_t size)
{
	struct net_buf *send_buf;
	int rc, len;

	/* make sure we're connected */
	rc = tcp_connect();
	if (rc < 0)
		return rc;

	send_buf = net_nbuf_get_tx(net_ctx);
	if (!send_buf) {
		printk("cannot create buf\n");
		return -EIO;
	}

	rc = net_nbuf_append(send_buf, size, (uint8_t *) buf);
	if (!rc) {
		printk("cannot write buf\n");
		return -EIO;
	}

	len = net_buf_frags_len(send_buf);
	k_sleep(TCP_TX_TIMEOUT);

	rc = net_context_send(send_buf, NULL, K_FOREVER, NULL, NULL);

	if (rc < 0) {
		printk("Cannot send data to peer (%d)\n", rc);
		net_nbuf_unref(send_buf);

		if (rc == -ESHUTDOWN)
			tcp_cleanup(true);

		return -EIO;
	} else {
		return len;
	}
}

int tcp_recv(unsigned char *buf, size_t size, int32_t timeout)
{
	int rc;

	/* make sure we're connected */
	rc = tcp_connect();
	if (rc < 0)
		return rc;

	net_context_recv(net_ctx, tcp_received_cb, K_NO_WAIT, NULL);
	/* wait here for the connection to complete or timeout */
	rc = k_sem_take(&sem_recv_wait, timeout);
	if (rc < 0 && rc != -ETIMEDOUT) {
		printk("tcp_recv: recv_wait sem error = %d\n", rc);
		return rc;
	}

	/* take a mutex here so we don't process any more data */
	k_sem_take(&sem_recv_mutex, K_FOREVER);

	/* copy the receive buffer into the passed in buffer */
	if (read_bytes > 0) {
		if (read_bytes > size)
			read_bytes = size;
		memcpy(buf, tcp_read_buf, read_bytes);
	}
	buf[read_bytes] = 0;
	rc = read_bytes;
	read_bytes = 0;

	k_sem_give(&sem_recv_mutex);

	return rc;
}
```

## src/tcp.h
```c
/*
 * Copyright (c) 2016 Linaro Limited
 *
 * Licensed under the Apache License, Version 2.0 (the "License");
 * you may not use this file except in compliance with the License.
 * You may obtain a copy of the License at
 *
 *     http://www.apache.org/licenses/LICENSE-2.0
 *
 * Unless required by applicable law or agreed to in writing, software
 * distributed under the License is distributed on an "AS IS" BASIS,
 * WITHOUT WARRANTIES OR CONDITIONS OF ANY KIND, either express or implied.
 * See the License for the specific language governing permissions and
 * limitations under the License.
 *
 */

#define TCP_RX_TIMEOUT K_SECONDS(3)

int tcp_send(const unsigned char *buf, size_t size);
int tcp_recv(unsigned char *buf, size_t size, int32_t timeout);
```
